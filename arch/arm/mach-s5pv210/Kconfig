## arch/arm/mach-s5pv210/Kconfig
```kconfig
if ARCH_S5PV210

choice
	prompt "S5PV210 board select"
	optional

#config TARGET_S5P_GONI
#	bool "S5P Goni board"
#	select OF_CONTROL

config TARGET_SMDKV210
	bool "Support smdkv210 board"
	select OF_CONTROL
	select SUPPORT_SPL

endchoice

config SYS_SOC
	default "s5pv210"

#source "board/samsung/goni/Kconfig"
source "board/samsung/smdkv210/Kconfig"

endif
```
